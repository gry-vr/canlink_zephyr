## boards/ffw/canlink/Kconfig.defconfig
```kconfig
if BOARD_CANLINK

config GPIO
    default y

config SERIAL
    default y

config CONSOLE
    default y



endif
```

## boards/ffw/canlink/board.yml
```yaml
board:
  name: canlink
  full_name: FFW CanLink
  vendor: others 
  socs:
    - name: stm32f767xx
```

## build/Kconfig/Kconfig.shield.defconfig
```kconfig
osource "/home/gry/zephyrproject/applications/canlink/boards/shields/*/Kconfig.defconfig"
```

## build/Kconfig/arch/Kconfig.tmp
```kconfig
# Load Zephyr Arch Kconfig descriptions.
osource "/home/gry/zephyrproject/zephyr/arch/rx/Kconfig"
osource "/home/gry/zephyrproject/zephyr/arch/x86/Kconfig"
osource "/home/gry/zephyrproject/zephyr/arch/xtensa/Kconfig"
osource "/home/gry/zephyrproject/zephyr/arch/sparc/Kconfig"
osource "/home/gry/zephyrproject/zephyr/arch/riscv/Kconfig"
osource "/home/gry/zephyrproject/zephyr/arch/posix/Kconfig"
osource "/home/gry/zephyrproject/zephyr/arch/openrisc/Kconfig"
osource "/home/gry/zephyrproject/zephyr/arch/mips/Kconfig"
osource "/home/gry/zephyrproject/zephyr/arch/arm64/Kconfig"
osource "/home/gry/zephyrproject/zephyr/arch/arm/Kconfig"
osource "/home/gry/zephyrproject/zephyr/arch/arc/Kconfig"
```

## build/Kconfig/boards/Kconfig.defconfig
```kconfig
# Load Zephyr board defconfig descriptions.
osource "/home/gry/zephyrproject/zephyr/boards/native/native_sim/Kconfig.defconfig"
```

## build/Kconfig/boards/Kconfig.native_sim
```kconfig
# Load board Kconfig descriptions.
osource "/home/gry/zephyrproject/zephyr/boards/native/native_sim/Kconfig.native_sim"
```

## build/Kconfig/boards/Kconfig.sysbuild.tmp
```kconfig
# Load Sysbuild board Kconfig descriptions.
osource "/home/gry/zephyrproject/zephyr/boards/native/native_sim/Kconfig.sysbuild"
```

## build/Kconfig/boards/Kconfig.tmp
```kconfig
# Load Zephyr board Kconfig descriptions.
osource "/home/gry/zephyrproject/zephyr/boards/native/native_sim/Kconfig"
```
